// Начало функции обработки кириллических символов при выводе на монитор серийного порта
String utf8rus(String source){     // Функция для конвертации русских символов из двубайтовой кодировки в однобайтовую

    int i,k;
    String target;
    unsigned char n;
    char m[2] = { '0', '\0' };
    k = source.length(); i = 0;
    while (i < k) {
    n = source[i]; i++;
 
    if (n >= 0xBF){
        switch (n) {
            case 0xD0: {
                n = source[i]; i++;
                if (n == 0x81) { n = 0xA8; break; }
                if (n >= 0x90 && n <= 0xBF) n = n + 0x30;
                break;
            }
            case 0xD1: {
                n = source[i]; i++;
                if (n == 0x91) { 
                    n = 0xB8; break; 
                }
                    if (n >= 0x80 && n <= 0x8F) {
                        n = n + 0x70;
                    }
                break;
            }
        }
    }
    m[0] = n; target = target + String(m); 
    }
    return target;
}
// Конец функции обработки кириллических симоволов

int ascii_cod(char x)
{
int a;
a = x;
return a;
}

int ascii_cod2(char x)
{
(int)x;
return x;
}




// Serial.println(adc64, 10);




////////////////////////////////////////////////////////////////

// MAIN::
    // ВКЛ : / ВЫКЛ ::     ПОДСВЕТКУ ДИСПЛЕЯ +

////////////////////////////////////////////////////////////////

// РУЧНОЕ УПРАВЛЕНИЕ ВКЛ/ВЫКЛ РЕЛЕ
    // НАЗАД ← / СВЕТ РЕЛЕ / ТЕРМО РЕЛЕ / ВЛАЖНОСТИ РЕЛЕ / ПОЛИВА РЕЛЕ:
                                                            // ВКЛ/ВЫКЛ
                                                            // ВКЛ. НА n МИНУТ

////////////////////////////////////////////////////////////////

// НАСТРОЙКА СВЕТОЦИКЛА:
    // НАЗАД ←
    /// 3 НЕДЕЛЬНЫЙ ТАЙМЕР(ПРОТОТИП ФУНКЦИИ)?
        // ?
    /// 2 ДОСВЕТКА:
            // 1 ВРЕМЯ ВКЛЮЧЕНИЯ РЕЛЕ:
                // НАСТРОЙКА+-:
            // 1 ВРЕМЯ ВЫКЛЮЧЕНИЯ РЕЛЕ:
                // НАСТРОЙКА+-:
            // 2 ВРЕМЯ ВКЛЮЧЕНИЯ РЕЛЕ:
                // НАСТРОЙКА+-:
            // 2 ВРЕМЯ ВЫКЛЮЧЕНИЯ РЕЛЕ:
                // НАСТРОЙКА+-:
            // СОХРАНИТЬ*
            // НАЗАД ←
    /// 1 СВЕТОЦИКЛ:
            // ВРЕМЯ ВКЛЮЧЕНИЯ РЕЛЕ:
                // НАСТРОЙКА+-:
            // ВРЕМЯ ВЫКЛЮЧЕНИЯ РЕЛЕ:
                // НАСТРОЙКА+-:
            // СОХРАНИТЬ*
            // НАЗАД ←
    /// 0 ВЫКЛЮЧЕН РУЧНОЙ РЕЖИМ:
            // УСТАНОВИТЬ ТИП ТАЙМЕРА 0. СОХРАНИТЬ*
            // НАЗАД ←

////////////////////////////////////////////////////////////////

// НАСТРОЙКА РЕЛЕ ТЕМПЕРАТУРЫ
    // 3 НАСТРАИВАЕМЫЙ
        // ТЕМПЕРАТУРА ВКЛ/ ТЕМПЕРАТУРА ВЫКЛ/ СОХРАНИТЬ/ ОТМЕНА
    // 2 НАГРЕВ
        // ЖЕЛАЕМАЯ ТЕМПЕРАТУРА/ ГИСТЕРЕЗИС/ СОХРАНИТЬ/ ОТМЕНА
    // 1 ОХЛАЖДЕНИЕ
        // ЖЕЛАЕМАЯ ТЕМПЕРАТУРА/ ГИСТЕРЕЗИС/ СОХРАНИТЬ/ ОТМЕНА
    // 0 ОТКЛЮЧЕНО

////////////////////////////////////////////////////////////////

// НАСТРОЙКА РЕЛЕ ВЛАЖНОСТИ
    // 3 НАСТРАИВАЕМЫЙ
        // ВЛАЖНОСТЬ ВКЛ/ ВЛАЖНОСТЬ ВЫКЛ/ СОХРАНИТЬ/ ОТМЕНА
    // 2 УВЛАЖНЕНИЕ
        // ЖЕЛАЕМАЯ ВЛАЖГОСТЬ/ ГИСТЕРЕЗИС/ СОХРАНИТЬ/ ОТМЕНА
    // 1 СУШКА
        // ЖЕЛАЕМАЯ ВЛАЖНОСТЬ/ ГИСТЕРЕЗИС/ СОХРАНИТЬ/ ОТМЕНА
    // 0 ОТКЛЮЧЕНО

////////////////////////////////////////////////////////////////

// НАСТРОЙКА РЕЛЕ АВТОПОЛИВА
    // 3 ОТ ДАТЧИКА ВЛАЖНОСТИ
        // 0, 1, 2-АНАЛОГОВЫЙ/ ПОРОГ СРАБОТКИ АНАЛОГОВОГО ДАТЧИКА/ СОХРАНИТЬ/ ОТМЕНА
    // 2 ПО ВРЕМЕНИ
        // ВРЕМЯ 1/ ВРЕМЯ 2/ ВРЕМЯ 3/ ВРЕМЯ РАБОТЫ
    // 1 ЦИКЛИЧЕСКИЙ
        // ВРЕМЯ ОЖИДАНИЯ/ ВРЕМЯ РАБОТЫ
    // 0 ОТКЛЮЧЕНО

////////////////////////////////////////////////////////////////

// НАСТРОЙКА ЯРКОСТИ ДИСПЛЕЯ
    // + - НАСТРОЙКА/ СОХРАНИТЬ/ ОТМЕНА

////////////////////////////////////////////////////////////////

// НАСТРОЙКА ЧАСОВ, ВРЕМЯ И ДАТА
    // ГОД/ МЕСЯЦ/ ДЕНЬ/ ДЕНЬ НЕДЕЛИ/ ЧАСЫ/ МИНУТЫ/ СЕКУНДЫ/ СОХРАНИТЬ

////////////////////////////////////////////////////////////////